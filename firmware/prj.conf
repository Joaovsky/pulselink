## CMakeLists.txt
```
cmake_minimum_required(VERSION 3.20.0)
find_package(Zephyr REQUIRED HINTS $ENV{ZEPHYR_BASE})
project(pulselink_firmware)
target_sources(app PRIVATE src/main.cpp src/sim_sensor.c)
target_include_directories(app PRIVATE src)
```

## prj.conf
```kconfig
CONFIG_CPP=y
CONFIG_STD_CPP17=y
CONFIG_CAN=y
CONFIG_LOG=y
CONFIG_MAIN_STACK_SIZE=4096
CONFIG_CAN_NATIVE_LINUX=y
```

## app.overlay
```dts
/ {
    chosen { zephyr,canbus = &canhost; };

    canhost: canhost {
        compatible = "zephyr,native-linux-can";
        host-interface = "vcan0";
        status = "okay";
    };

    simsensor0: simsensor {
        compatible = "pulselink,simsensor";
        status = "okay";
    };
};
```

## dts/bindings/sensor/pulselink,simsensor.yaml
```yaml
description: PulseLink simulated sensor
compatible: "pulselink,simsensor"
include: base.yaml
```

## src/main.cpp
```c
#include <zephyr/kernel.h>
#include <zephyr/device.h>
#include <zephyr/drivers/can.h>
#include <zephyr/logging/log.h>
#include <string.h>
#include "control_fsm.hpp"
#include "sim_sensor.h"

LOG_MODULE_REGISTER(pulselink, LOG_LEVEL_INF);

static uint16_t crc16(const uint8_t* d, size_t n) {
    uint16_t crc = 0xFFFF;
    for (size_t i = 0; i < n; ++i) {
        crc ^= static_cast<uint16_t>(d[i]) << 8;
        for (int b = 0; b < 8; ++b)
            crc = (crc & 0x8000) ? static_cast<uint16_t>((crc << 1) ^ 0x1021)
                                 : static_cast<uint16_t>(crc << 1);
    }
    return crc;
}
static void pack(uint8_t o[8], uint8_t node, int16_t t, uint16_t v, uint8_t h) {
    o[0]=node; o[1]=t>>8; o[2]=t&0xFF; o[3]=v>>8; o[4]=v&0xFF; o[5]=h;
    const uint16_t c=crc16(o,6); o[6]=c>>8; o[7]=c&0xFF;
}
static void rx_cb(const struct device*, struct can_frame* f, void*) {
    LOG_INF("CAN RX loopback: node=%u health=%u", f->data[0], f->data[5]);
}

int main(void) {
    const struct device* can = DEVICE_DT_GET(DT_CHOSEN(zephyr_canbus));
    const struct device* sensor = DEVICE_DT_GET(DT_NODELABEL(simsensor0));
    if (!device_is_ready(can))    { LOG_ERR("CAN not ready");    return 0; }
    if (!device_is_ready(sensor)) { LOG_ERR("sensor not ready"); return 0; }
    can_start(can);

    struct can_filter filter = { .id = 0x123, .mask = CAN_STD_ID_MASK };
    can_add_rx_filter(can, rx_cb, nullptr, &filter);

    ControlFsm fsm;
    while (true) {
        int16_t temp = 0;
        sim_sensor_sample(sensor, &temp);              /* <-- vem do driver */
        const uint16_t vib = static_cast<uint16_t>(temp / 4);
        const Health h = fsm.update(temp, vib);

        uint8_t buf[8];
        pack(buf, 1, temp, vib, static_cast<uint8_t>(h));
        struct can_frame frame{};
        frame.id = 0x123; frame.dlc = 8;
        memcpy(frame.data, buf, 8);
        can_send(can, &frame, K_FOREVER, nullptr, nullptr);

        LOG_INF("CAN TX: temp=%d.%02dC vib=%u health=%d",
                temp/100, (temp%100+100)%100, vib, static_cast<int>(h));
        k_sleep(K_MSEC(500));
    }
    return 0;
}
```

## src/control_fsm.hpp
```c
#pragma once
#include <cstdint>

enum class Health : uint8_t { NORMAL = 0, WARNING = 1, FAULT = 2 };

class ControlFsm {
public:
    Health update(int16_t temp, uint16_t vib) {
        if (temp >= 8000 || vib >= 6000)      state_ = Health::FAULT;
        else if (temp >= 6000 || vib >= 3000) state_ = Health::WARNING;
        else                                  state_ = Health::NORMAL;
        return state_;
    }
    Health state() const { return state_; }
private:
    Health state_ = Health::NORMAL;
};
```

## src/sim_sensor.c
```c
#define DT_DRV_COMPAT pulselink_simsensor
#include <zephyr/device.h>
#include <zephyr/logging/log.h>
#include "sim_sensor.h"
LOG_MODULE_REGISTER(simsensor, LOG_LEVEL_INF);

// Estado do driver: apenas um valor de temperatura simulado.
struct simsensor_data { int16_t temp; };

// Implementação de `sample`: atualiza o valor simulado e retorna-o via *out.
// Incremento fixo (137 representa 1.37°C) e wrap-around para manter faixa.
static int simsensor_sample(const struct device *dev, int16_t *out) {
    struct simsensor_data *d = (struct simsensor_data *)dev->data;
    d->temp = (int16_t)(d->temp + 137);      /* passo distintivo: 1.37C */
    if (d->temp > 9000) d->temp = 2000;
    *out = d->temp;
    return 0; // 0 = sucesso
}

// Tabela de funções exposta pelo driver (ligada a `dev->api`).
static const struct simsensor_api api = { .sample = simsensor_sample };

// Inicialização do dispositivo: configura estado inicial e registra mensagem.
static int simsensor_init(const struct device *dev) {
    ((struct simsensor_data *)dev->data)->temp = 2000;
    LOG_INF("=== SIMSENSOR DRIVER ONLINE (custom devicetree driver) ===");
    return 0;
}

// Macro que instancia o dispositivo para cada nó do devicetree com status "okay".
#define SIMSENSOR_INIT(inst)                                          \
    static struct simsensor_data simsensor_data_##inst;               \
    DEVICE_DT_INST_DEFINE(inst, simsensor_init, NULL,                 \
        &simsensor_data_##inst, NULL, POST_KERNEL,                    \
        CONFIG_KERNEL_INIT_PRIORITY_DEVICE, &api);

DT_INST_FOREACH_STATUS_OKAY(SIMSENSOR_INIT)
```

## src/sim_sensor.h
```c
#pragma once
#include <zephyr/device.h>
#include <stdint.h>
#ifdef __cplusplus
extern "C" {
#endif
// API (tabela de funções) que um driver de sensor simulado deve expor.
// Contém apenas a operação necessária: obter uma amostra.
struct simsensor_api {
    // Preenche *out com a amostra; retorna 0 em sucesso, <0 em erro.
    int (*sample)(const struct device *dev, int16_t *out);
};

// Helper inline: obtém a tabela `simsensor_api` de `dev->api` e chama `sample`.
// Use esta função para ler uma amostra sem fazer cast manual.
static inline int sim_sensor_sample(const struct device *dev, int16_t *out) {
    const struct simsensor_api *api = (const struct simsensor_api *)dev->api;
    return api->sample(dev, out);
}

#ifdef __cplusplus
}
#endif
```
